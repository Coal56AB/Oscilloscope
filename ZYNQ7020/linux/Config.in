## ZYNQ7020/linux/board/image.its
```
/dts-v1/;

/ {
    description = "Oscill Linux FIT";
    #address-cells = <1>;

    images {
        kernel {
            description = "Linux zImage";
            data = /incbin/("zImage");
            type = "kernel";
            arch = "arm";
            os = "linux";
            compression = "none";
            load = <0x03000000>;
            entry = <0x03000000>;
            hash-1 { algo = "sha256"; };
        };

        ramdisk {
            description = "BusyBox gzip initramfs";
            data = /incbin/("rootfs.cpio.gz");
            type = "ramdisk";
            arch = "arm";
            os = "linux";
            /* Linux decompresses the initramfs; U-Boot copies it as-is. */
            compression = "none";
            load = <0x08000000>;
            hash-1 { algo = "sha256"; };
        };

        fdt {
            description = "Oscill ZYNQ MINI rev B device tree";
            data = /incbin/("oscill-zynq7020.dtb");
            type = "flat_dt";
            arch = "arm";
            compression = "none";
            load = <0x02000000>;
            hash-1 { algo = "sha256"; };
        };
    };

    configurations {
        default = "conf";
        conf {
            description = "XC7Z020 QSPI Linux";
            kernel = "kernel";
            ramdisk = "ramdisk";
            fdt = "fdt";
        };
    };
};
```

## ZYNQ7020/linux/configs/oscill_userspace_defconfig
```kconfig
BR2_arm=y
BR2_cortex_a9=y
BR2_ARM_ENABLE_NEON=y
BR2_ARM_ENABLE_VFP=y
BR2_ARM_EABIHF=y
BR2_TOOLCHAIN_BUILDROOT_GLIBC=y
BR2_KERNEL_HEADERS_6_6=y
BR2_TARGET_GENERIC_HOSTNAME="oscill"
BR2_TARGET_GENERIC_ISSUE="Oscill"
BR2_ROOTFS_OVERLAY="$(BR2_EXTERNAL_OSCILL_PATH)/rootfs-overlay"
BR2_PACKAGE_SDL2=y
BR2_PACKAGE_LIBDRM=y
BR2_PACKAGE_OSCILL=y
BR2_PACKAGE_EVTEST=y
BR2_PACKAGE_USBUTILS=y
BR2_PACKAGE_EXFATPROGS=y
BR2_TARGET_ROOTFS_SQUASHFS=y
BR2_TARGET_ROOTFS_SQUASHFS4_XZ=y
# Board-specific kernel, bootloader and FSBL require a verified Vivado handoff.
```

## ZYNQ7020/linux/configs/oscill_zynq_defconfig
```kconfig
BR2_arm=y
BR2_cortex_a9=y
BR2_ARM_ENABLE_NEON=y
BR2_ARM_ENABLE_VFP=y
BR2_ARM_EABIHF=y
BR2_TOOLCHAIN_EXTERNAL=y
BR2_TOOLCHAIN_EXTERNAL_BOOTLIN=y
BR2_TOOLCHAIN_EXTERNAL_BOOTLIN_ARMV7_EABIHF_GLIBC_STABLE=y
BR2_TARGET_GENERIC_HOSTNAME="oscill"
BR2_TARGET_GENERIC_ISSUE="Oscill"
BR2_TARGET_GENERIC_GETTY_PORT="ttyPS0"
BR2_ROOTFS_OVERLAY="$(BR2_EXTERNAL_OSCILL_PATH)/rootfs-overlay"
BR2_ROOTFS_POST_BUILD_SCRIPT="$(BR2_EXTERNAL_OSCILL_PATH)/board/post-build.sh"
BR2_ROOTFS_POST_IMAGE_SCRIPT="$(BR2_EXTERNAL_OSCILL_PATH)/board/post-image.sh"
BR2_GLOBAL_PATCH_DIR="$(BR2_EXTERNAL_OSCILL_PATH)/board/patches"
BR2_LINUX_KERNEL=y
BR2_LINUX_KERNEL_CUSTOM_TARBALL=y
BR2_LINUX_KERNEL_CUSTOM_TARBALL_LOCATION="https://github.com/Xilinx/linux-xlnx/archive/3c22f2aad113cbbea5c6434c697d002a82826da9.tar.gz"
BR2_LINUX_KERNEL_DEFCONFIG="xilinx_zynq"
BR2_LINUX_KERNEL_CONFIG_FRAGMENT_FILES="$(BR2_EXTERNAL_OSCILL_PATH)/kernel.fragment"
BR2_LINUX_KERNEL_ZIMAGE=y
BR2_LINUX_KERNEL_DTS_SUPPORT=y
BR2_LINUX_KERNEL_CUSTOM_DTS_PATH="$(BR2_EXTERNAL_OSCILL_PATH)/board/oscill-zynq7020.dts $(BR2_EXTERNAL_OSCILL_PATH)/board/oscill-board.dtsi $(BR2_EXTERNAL_OSCILL_PATH)/board/ps-peripherals.dtsi"
BR2_TARGET_UBOOT=y
BR2_TARGET_UBOOT_BUILD_SYSTEM_KCONFIG=y
BR2_TARGET_UBOOT_CUSTOM_VERSION=y
BR2_TARGET_UBOOT_CUSTOM_VERSION_VALUE="2024.10"
BR2_TARGET_UBOOT_BOARD_DEFCONFIG="xilinx_zynq_virt"
BR2_TARGET_UBOOT_CONFIG_FRAGMENT_FILES="$(BR2_EXTERNAL_OSCILL_PATH)/board/uboot.fragment"
BR2_TARGET_UBOOT_CUSTOM_DTS_PATH="$(BR2_EXTERNAL_OSCILL_PATH)/board/oscill-zynq7020-uboot.dts $(BR2_EXTERNAL_OSCILL_PATH)/board/oscill-board.dtsi $(BR2_EXTERNAL_OSCILL_PATH)/board/ps-peripherals.dtsi"
BR2_TARGET_UBOOT_NEEDS_DTC=y
BR2_TARGET_UBOOT_FORMAT_REMAKE_ELF=y
BR2_PACKAGE_HOST_UBOOT_TOOLS=y
BR2_PACKAGE_HOST_UBOOT_TOOLS_FIT_SUPPORT=y
BR2_PACKAGE_HOST_UBOOT_TOOLS_BOOT_SCRIPT=y
BR2_PACKAGE_HOST_UBOOT_TOOLS_BOOT_SCRIPT_SOURCE="$(BR2_EXTERNAL_OSCILL_PATH)/board/boot.cmd"
BR2_PACKAGE_SDL2=y
BR2_PACKAGE_OSCILL=y
BR2_PACKAGE_EVTEST=y
BR2_PACKAGE_EXFATPROGS=y
BR2_TARGET_ROOTFS_SQUASHFS=y
BR2_TARGET_ROOTFS_SQUASHFS4_XZ=y
BR2_TARGET_ROOTFS_CPIO=y
BR2_TARGET_ROOTFS_CPIO_GZIP=y
```

## ZYNQ7020/linux/package/oscill/Config.in
```kconfig
config BR2_PACKAGE_OSCILL
    bool "oscill"
    depends on BR2_TOOLCHAIN_HAS_THREADS
    depends on !BR2_STATIC_LIBS
    select BR2_PACKAGE_SDL2
    help
      Oscilloscope GUI with software rendering, framebuffer and USB touch input.
      Selecting libdrm also enables the direct DRM backend.
```
