/**
**************************************************************************
* @file font5x7.c
* @brief Таблица символов общего шрифта 5x7.
**************************************************************************
*/
#include "oled_font.h"

#include <stddef.h>

static const uint8_t FontDigits[][5] =
{
  {0x3EU, 0x51U, 0x49U, 0x45U, 0x3EU}, /* 0 */
  {0x00U, 0x42U, 0x7FU, 0x40U, 0x00U}, /* 1 */
  {0x42U, 0x61U, 0x51U, 0x49U, 0x46U}, /* 2 */
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  {0x06U, 0x49U, 0x49U, 0x29U, 0x1EU}  /* 9 */
};

static const uint8_t FontLetters[][5] =
{
  {0x7EU, 0x11U, 0x11U, 0x11U, 0x7EU}, /* A */
  {0x7FU, 0x49U, 0x49U, 0x49U, 0x36U}, /* B */
  {0x3EU, 0x41U, 0x41U, 0x41U, 0x22U}, /* C */
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  {0x61U, 0x51U, 0x49U, 0x45U, 0x43U}  /* Z */
};

static const uint8_t GlyphColon[5]   = {0x00U, 0x36U, 0x36U, 0x00U, 0x00U};
static const uint8_t GlyphPercent[5] = {0x63U, 0x13U, 0x08U, 0x64U, 0x63U};
static const uint8_t GlyphDash[5]    = {0x08U, 0x08U, 0x08U, 0x08U, 0x08U};
static const uint8_t GlyphDot[5]     = {0x00U, 0x60U, 0x60U, 0x00U, 0x00U};
static const uint8_t GlyphSlash[5]   = {0x20U, 0x10U, 0x08U, 0x04U, 0x02U};

const uint8_t *Font5x7_GetGlyph(char symbol)
{
  if(symbol >= '0' && symbol <= '9')
    return FontDigits[(unsigned)(symbol - '0')];
  if(symbol >= 'a' && symbol <= 'z')
    symbol = (char)(symbol - 'a' + 'A');
  if(symbol >= 'A' && symbol <= 'Z')
    return FontLetters[(unsigned)(symbol - 'A')];

  switch(symbol)
  {
    case ':': return GlyphColon;
    case '%': return GlyphPercent;
    case '-': return GlyphDash;
    case '.': return GlyphDot;
    case '/': return GlyphSlash;
    default: return NULL;
  }
}
